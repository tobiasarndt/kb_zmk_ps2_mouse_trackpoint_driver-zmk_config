/*
 * Copyright (c) 2020 Pete Johanson
 *
 * SPDX-License-Identifier: MIT
 */

#include "corne_tp.dtsi"

&kscan0 {
    col-gpios
        = <&xiao_d 21 GPIO_ACTIVE_HIGH>
        , <&xiao_d 20 GPIO_ACTIVE_HIGH>
        , <&xiao_d 19 GPIO_ACTIVE_HIGH>
        , <&xiao_d 18 GPIO_ACTIVE_HIGH>
        , <&xiao_d 15 GPIO_ACTIVE_HIGH>
        , <&xiao_d 14 GPIO_ACTIVE_HIGH>
        ;
};
